#include <reg51.h> // 8051 header file 
unsigned char Column[8]= { 0x80, 0x40, 0x20, 0x10, 0x08, 0x04, 0x02, 0x01}; // Column Data in Array
unsigned char Row[102] = {  0x00, 0x3F, 0x48, 0x88, 0x48, 0x3F, //A
														0x00, 0xFF, 0x91, 0x91, 0x91, 0x6E, //B
														0x00, 0x7E, 0x81, 0x81, 0x81, 0x42, //C
														0x00, 0xFF, 0x81, 0x81, 0x81, 0x7E, //D
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													  0x00, 0x7E, 0x81, 0x81, 0x7E, 0x01,}; //Q
void Delay(unsigned int num) //Delay Function
{
		unsigned int i,j; //Define Variable
		for(i=0;i<num;i++) //For Loop For Delay 
		for(j=0;j<600;j++);//For Loop For Delay
}
unsigned char i, j, k, l, m; // Define Variable
void main()// Main program
{
			i=0; //Initial Value is 0
			j=0; //Initial Value is 0
		 while(1) //Repeat forever
				{
					for (m=0; m<20; m++)
					{
						for (i=0;i<8; i++)
						{
							P1 =Column[i]; // Send Column Data To P1
							P2 =Row[j];// Send Row Data To P2 
							Delay(1); //Delay 
							j++; // Increment j value with 1
							if(j==102) j = 0;
						}
						j=l;
						if(l==102) l=0;
				}
					l++;
				j=l;
		}
	}

