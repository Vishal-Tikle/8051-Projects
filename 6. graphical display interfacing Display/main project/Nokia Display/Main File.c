#include<reg52.h>
sbit CLK=P2^1;
sbit DIN=P2^2;
sbit DC=P2^3;
sbit CE=P2^4;
sbit RST=P2^5;

void Send(unsigned char);
void Data(unsigned char);
void Cmd(unsigned char);
void setPixel(unsigned char, unsigned char);
void setCursor(unsigned char, unsigned char);
void allClear(void);
void Initialize_LCD(void);
void charDisp(unsigned char);
void stringDisp(unsigned char*);

unsigned char code  Graphics [] = {
0xff, 0xff, 0xff, 0xff, 0xff, 0xff, 0xff, 0xff, 0xff, 0xff, 0xff, 0xff,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 0xff, 
};

const unsigned char code LookUpTable [][5] =
{
{ 0x00, 0x00, 0x00, 0x00, 0x00 },  // space
{ 0x00, 0x00, 0x2f, 0x00, 0x00 },   // !
{ 0x00, 0x07, 0x00, 0x07, 0x00 },   // "
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{ 0x00, 0x08, 0x3e, 0x41, 0x00 }    // {
};

void Send(unsigned char a){
unsigned char i;
for(i=0;i<8;i++){
CLK = 0;
if((a&0x80)){
DIN = 1;
} else {
DIN = 0;
}
CLK = 1;
a <<= 1;
}
}

void Data(unsigned char x){
DC = 1;
CE = 0;
Send(x);
CE = 1;
}

void Cmd(unsigned char x){
DC = 0;
CE = 0;
Send(x);
CE = 1;
}

/* Brings ram pointer to X,Y pixel position            */
/* Input Arguments: x-> X cordinate range from 0 to 83 */
/* Input Arguments: y-> Y cordinate range from 0 to 5  */

void setPixel(unsigned char x, unsigned char y)
{
Cmd(0x40|(y&0x07));	// Y axis
Cmd(0x80|(x&0x7f));	// X axis
}
/* Clears the screen */

void allClear(void)
{
int pixel;
setPixel(0,0);										// Cursor Home.
for (pixel=504;pixel>0;pixel--)	{Data(0x00);}		// 6*84 = 504 DDRAM addresses.
}
/* Nokia3310 LCD Initialization */

void Initialize_LCD(void)
{
RST = 1;	// Set _RES HIGH.
CE = 1;		// Disable Chip.
Cmd(0x21);		// Activate Chip and H=1.
Cmd(0xb2);		// Set LCD Voltage to about 7V.
Cmd(0x13);		// Adjust voltage bias.
Cmd(0x20);		// Horizontal addressing and H=0.
Cmd(0x09);		// Activate all segments.
allClear();			// Erase all pixel on the DDRAM.
Cmd(0x08);		// Blank the Display.
Cmd(0x0C);		// Display Normal.
setPixel(0,0);		// Cursor Home.
}
/* Bring cursor to Line and character specified                     */
/* Input Arguments: row    -> Line number range from 1 to 6         */
/* Input Arguments: Column -> character position range from 1 to 14 */
/* You can have maximum of 6 lines of text on LCD and each line
containing 14 characters. Address is auto increment              */

void setCursor(unsigned char row, unsigned char col){
if((row>6) || (row<1) || (col<1) || (col>14))
return;
setPixel(((col-1)*6),(row-1));
}
/* Writes single character on LCD                   */
/* Input Arguments: ch -> Character to be displayed */

void charDisp(unsigned char a){
unsigned char i, b;
if ( (a < 0x20) || (a > 0x7c) ){
a = 92;
}
for(i=0;i<5;i++){
b = LookUpTable[a - 32][i] << 1;
Data(b);
}
Data(0x00);
}
/* Writes character string on LCD                            */
/* Input Arguments: str -> Pointer to string to be displayed */

void stringDisp(unsigned char *p){
while(*p)
charDisp(*p++);
}
void Delay(int k)
{
int i,j;
for(i=0;i<k;i++)
for(j=0;j<1000;j++);
}


void main(){
int i;
Initialize_LCD();
//Bring Cursor to Line 1, character 1
setCursor(3,2);
//Print string to LCD
stringDisp("Group No. 09");
Delay(1000);
setCursor(3,2);
stringDisp("ETC 3rd Year");
Delay(1000);
//Bring pointer to 0,0 pixel position
setPixel(0,0);
//Write gfx data on LCD
for(i=0;i<504;i++)
Data(Graphics[i]);
while(1);
}